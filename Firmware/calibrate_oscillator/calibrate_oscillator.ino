// =============================================================================
// Hexagon Art Piece — Oscillator Calibration Sketch
// =============================================================================
//
// PURPOSE
// -------
// This sketch is uploaded once per ATtiny1616 during manufacturing to calibrate
// the internal 20 MHz RC oscillator against a known external timebase. It finds
// the OSCCAL register value that brings the oscillator closest to 20.000 MHz
// and stores that value in the USERROW (User Signature Row) where it survives
// chip erase, "Burn Bootloader", and firmware re-flashing.
//
// The hexagon firmware reads this value on every boot via clockcalBegin() and
// applies it immediately — no UART calibration dance needed.
//
// BACKGROUND
// ----------
// The ATtiny1616 internal 20 MHz oscillator has unit-to-unit variation of ±1–2%
// from the factory. Over many stepper revolutions (4096 half-steps per output
// shaft revolution), this drift accumulates into visible timing errors between
// hexagon units during choreographed movement.
//
// Our units are too cost-sensitive for a crystal (no 32.768 kHz crystal is
// populated on the production board; the footprint exists but is left empty).
// Instead, we calibrate each unit once at manufacturing time using an external
// 500 Hz square-wave reference generated by an Arduino Uno with a crystal
// oscillator.
//
// APPROACH
// --------
// This sketch uses the same measurement technique as Spence Konde's
// megaTinyTuner (megaTinyCore), simplified for our single-target use case:
//
//   1. An Arduino Uno running the 500HzReference sketch outputs a 500 Hz square
//      wave on pin 9. This signal is connected to PA6 on the ATtiny1616.
//      The Uno's crystal oscillator (±50ppm typical) is our timebase.
//
//   2. The ATtiny1616's main clock is set to /4 prescale so the CPU can safely
//      step through OSCCAL values without crashing on unstable intermediate
//      frequencies.
//
//   3. At each OSCCAL value (0–63), we use pulseIn() to measure 8 consecutive
//      LOW pulses from the 500 Hz reference. At exactly 20.000 MHz, each LOW
//      period is 1.000 ms, so 8 pulses sum to 8000 µs.
//
//   4. The OSCCAL value whose measured pulse sum is closest to 8000 is the
//      calibrated setting.
//
//   5. That value is written to USERROW byte 0. The USERROW is a 32-byte
//      non-volatile region that survives chip erase — calibration persists
//      across all subsequent firmware updates.
//
// HARDWARE CONNECTIONS (calibration jig)
// --------------------------------------
//
//   Arduino Uno GND  ────→  ATtiny1616 GND  (pin 10 on SOIC-20)
//   Arduino Uno Pin 9 ────→  ATtiny1616 PA6  (pin 4 on SOIC-20)
//   Arduino Uno 5V   ────→  ATtiny1616 VDD  (pin 1 on SOIC-20) [optional]
//
//   The ATtiny1616 can be powered from the Uno's 5V rail or from a separate
//   supply. If using separate supplies, ensure they share a common ground and
//   the Uno's 5V output is within 0.5V of the ATtiny's VDD.
//
//   The UPDI programmer is NOT required during calibration — flash this sketch
//   first, then move the board to the calibration jig (Uno providing power +
//   500 Hz signal).
//
// STATUS LED INDICATION (PB1)
// ---------------------------
//   Power on:   LED off (during setup)
//   Cal start:  3 slow blinks (200ms on, 200ms off) → entering measurement
//   Measuring:   LED flickers rapidly as OSCCAL values are swept
//   Success:     LED solid ON — calibrated value written to USERROW
//   Failure:     LED blinks S-O-S pattern (3 short, 3 long, 3 short) —
//                no OSCCAL value was close enough to 8000 µs
//
// WHAT THE CALIBRATION JIG OPERATOR SEES
// --------------------------------------
//   1. Flash this sketch to the ATtiny1616 via UPDI.
//   2. Move the board to the calibration jig (powered by Uno, 500Hz on PA6).
//   3. LED blinks 3 times slowly (~1 second) → measurement starts.
//   4. LED flickers for ~2 seconds while 64 OSCCAL values are tested.
//   5. LED goes solid ON → calibration success. Board is done.
//   6. Remove from jig. Flash the production firmware.
//
// DEPENDENCIES
// ------------
//   - megaTinyCore board package (https://github.com/SpenceKonde/megaTinyCore)
//   - Board: ATtiny1616 (or 1606/3216 — same oscillator block)
//   - Clock: 20 MHz Internal (no tuning option selected — we ARE the tuning)
//   - millis() must be DISABLED (sketch handles timing directly)
//
// USERROW LAYOUT
// --------------
//   Byte 0: Calibrated OSCCAL value (0x00–0x3F) or 0xFF if never calibrated
//   Bytes 1–31: Reserved for future use
//
// The production firmware's clockcal module should be updated to read from
// USERROW byte 0 instead of EEPROM 0x01. See clockcal.cpp.
//
// REFERENCE
// ---------
//   megaTinyTuner by Spence Konde (megaTinyCore)
//   https://github.com/SpenceKonde/megaTinyCore/blob/master/megaavr/libraries/
//     megaTinyCore/examples/megaTinyTuner/megaTinyTuner.ino
//
//   ATtiny1616 Datasheet §32.3.5 (User Row), §11.3 (CLKCTRL)
//
// =============================================================================

#include <avr/cpufunc.h>
#include <avr/io.h>
#include <util/delay.h>

// ---------------------------------------------------------------------------
// Pin assignments — matches the hexagon PCB
// ---------------------------------------------------------------------------

// 500 Hz reference input from Arduino Uno pin 9.
// PA6 (physical pin 4 on SOIC-20) is unused on the hexagon PCB:
// stepper uses PC0–3, endstop uses PB0, status LED uses PB1,
// UART uses PB2/PB3, UPDI uses PA0.
#define TUNING_PIN PIN_PA6

// Status LED — same pin the hexagon firmware uses (PB1).
#define STATUS_LED PIN_PB1

// ---------------------------------------------------------------------------
// Calibration parameters
// ---------------------------------------------------------------------------

// Expected pulseIn() sum for 8 LOW pulses of a 500 Hz square wave
// at exactly 20.000 MHz with /4 prescale.
//
// IMPORTANT: pulseIn() calculates microseconds using F_CPU as a compile-time
// constant (20000000). While the CPU actually runs at 5 MHz under /4 prescale,
// pulseIn's busy-loop still executes 4× as many iterations per wall-clock µs
// as it expects — so it *under-reports* pulse widths by 4×.
//
// A true 1000 µs LOW period at 5 MHz CPU is reported by pulseIn as ~250 µs.
// 8 pulses × 250 µs = 2000 µs.
#define TARGET_PULSE_SUM 2000UL

// Number of LOW pulses to measure per OSCCAL value.
// 8 gives a ~16 ms measurement window — enough averaging to reject jitter
// while keeping total sweep time under 2 seconds.
#define PULSE_COUNT 8

// Acceptable tolerance around TARGET_PULSE_SUM, in µs.
// ±38 µs at 2000 µs ≈ ±1.9% — scaled from the original ±150 µs @ 8000 µs
// by the same /4 factor. The closest value within this window wins.
// If no value falls within tolerance, calibration fails.
#define ACCEPTABLE_TOLERANCE 38

// ---------------------------------------------------------------------------
// USERROW access
// ---------------------------------------------------------------------------

// ATtiny1616 USERROW (User Signature Row): 32 bytes at 0x1300.
// Writing requires the Page Erase and Write NVM command with SPM unlock.
// Survives chip erase.

static void userrowWrite(uint8_t offset, uint8_t value) {
  // Write the byte to the mapped USERROW address.
  // The USERROW is memory-mapped at USER_SIGNATURES_START (0x1300).
  *(volatile uint8_t*)(0x1300 + offset) = value;

  // Issue the Page Erase and Write command via NVMCTRL.
  // NVMCTRL.CTRLA is a CCP-protected register requiring the SPM unlock key.
  // _PROTECTED_WRITE_SPM handles the CCP unlock sequence.
  _PROTECTED_WRITE_SPM(NVMCTRL.CTRLA, NVMCTRL_CMD_PAGEERASEWRITE_gc);

  // Wait for the NVM operation to complete.
  // USERROW is treated as flash, so poll FBUSY; also guard EEBUSY for safety.
  while (NVMCTRL.STATUS & (NVMCTRL_FBUSY_bm | NVMCTRL_EEBUSY_bm));
}

static uint8_t userrowRead(uint8_t offset) {
  return *(volatile uint8_t*)(0x1300 + offset);
}

// ---------------------------------------------------------------------------
// Status LED helpers
// ---------------------------------------------------------------------------

static void ledOn() { digitalWrite(STATUS_LED, HIGH); }
static void ledOff() { digitalWrite(STATUS_LED, LOW); }

// Blink the LED N times with the given on/off durations in ms.
// _delay_ms() requires a compile-time constant; we use a counted spin loop
// (1 ms per iteration at ~5 MHz effective clock) to accept runtime values.
static void delayMs(uint16_t ms) {
  while (ms--) {
    _delay_us(1000);
  }
}

static void blinkPattern(uint8_t count, uint16_t onMs, uint16_t offMs) {
  for (uint8_t i = 0; i < count; i++) {
    ledOn();
    delayMs(onMs);
    ledOff();
    delayMs(offMs);
  }
}

// Error blink — flash a diagnostic code (N slow pulses) then repeat SOS.
//
//   1 long blink = no reference signal detected (wiring / Uno not running)
//   2 long blinks = signal received but no OSCCAL value within tolerance
//                   (wrong target freq, prescale mismatch, bad oscillator)
//   3 long blinks = USERROW write verify failed (NVM hardware problem)
//
static void blinkError(uint8_t code) {
  while (1) {
    // Diagnostic prefix: N long blinks.
    _delay_ms(500);
    blinkPattern(code, 600, 300);
    _delay_ms(800);
    // SOS.
    blinkPattern(3, 100, 100);  // S
    _delay_ms(300);
    blinkPattern(3, 400, 100);  // O
    _delay_ms(300);
    blinkPattern(3, 100, 100);  // S
    _delay_ms(800);
  }
}

// ---------------------------------------------------------------------------
// Safely set the OSCCAL register and prescaler
// ---------------------------------------------------------------------------

// Write OSCCAL with prescale /4 for safe frequency stepping.
// The /4 prescale keeps the CPU clock ≤ 5 MHz even at max OSCCAL (which
// can push the oscillator above 30 MHz on some units), preventing crashes
// during the sweep.
static void setOSCCALWithPrescale4(uint8_t cal) {
  // Enable /4 prescale FIRST so any overshoot during OSCCAL write is safe.
  _PROTECTED_WRITE(CLKCTRL_MCLKCTRLB, 0x03);  // PEN=1, PDIV=4 → /4
  _NOP();

  // Write the new OSCCAL value.
  _PROTECTED_WRITE(CLKCTRL_OSC20MCALIBA, cal & 0x3F);
  _NOP();
}

// Restore the stock (factory) OSCCAL after calibration sweep.
static void restoreStockOSCCAL(uint8_t stockCal) {
  _PROTECTED_WRITE(CLKCTRL_MCLKCTRLB, 0x03);  // /4 prescale for safety
  _NOP();
  _PROTECTED_WRITE(CLKCTRL_OSC20MCALIBA, stockCal & 0x3F);
  _NOP();
  _PROTECTED_WRITE(CLKCTRL_MCLKCTRLB, 0x00);  // prescale off
}

// ---------------------------------------------------------------------------
// Disable millis interrupt
// ---------------------------------------------------------------------------

// The tuning sketch must own the timer — millis() interferes with timing.
// The Boards menu option "millis()/micros(): Disabled" sets
// MILLIS_USE_TIMERNONE. If the user forgets, the #warning catches it at
// compile time and the empty init_millis() override prevents the core from
// starting the timer despite the wrong menu setting.
#if !defined(MILLIS_USE_TIMERNONE)
#warning \
    "Millis must be DISABLED for calibration — set Tools → millis()/micros() → Disabled"
// Safety net: prevent timer init even if the menu setting is wrong.
void init_millis() {}
#endif

// ---------------------------------------------------------------------------
// setup()
// ---------------------------------------------------------------------------

void setup() {
  // --- Pin setup ---
  pinMode(STATUS_LED, OUTPUT);
  ledOff();

  pinMode(TUNING_PIN, INPUT);  // 500 Hz reference from Arduino Uno

  // --- Announce start ---
  blinkPattern(3, 200, 200);  // 3 slow blinks = calibration starting

  // --- Read factory OSCCAL ---
  // The factory calibration value is stored in the signature row at:
  //   0x1100 + 24  for 16 MHz base
  //   0x1100 + 26  for 20 MHz base
  // We compile for 20 MHz, so offset 26.
  uint8_t stockCal = *(uint8_t*)(0x1100 + 26);
  uint8_t stockCal6bit = stockCal & 0x3F;  // only bits 5:0 are used

  // --- Sweep all 64 OSCCAL values ---
  // The ATtiny 0/1-series has a 6-bit OSCCAL register (0–63).
  // At each value we measure 8 LOW pulses and compare the sum to the target.

  int16_t bestOSCCAL = -1;
  uint32_t bestError = UINT32_MAX;
  bool gotAnyPulse = false;  // set true the first time pulseIn returns non-zero

  for (uint16_t cal = 0; cal < 64; cal++) {
    // Set OSCCAL with /4 prescale — safe stepping.
    setOSCCALWithPrescale4((uint8_t)cal);
    _delay_us(500);  // let the oscillator settle

    // Measure PULSE_COUNT LOW pulses from the reference signal.
    // pulseIn() returns microseconds. Each measurement is bounded to
    // 2000 µs — a LOW period longer than 2 ms means the signal is missing.
    uint32_t pulseSum = 0;
    uint8_t validPulses = 0;

    for (uint8_t p = 0; p < PULSE_COUNT; p++) {
      // Timeout is generous (20 ms) to handle the full OSCCAL range.
      // At high OSCCAL values the CPU clock is fast, making pulseIn's
      // internal µs counter tick faster than wall time — a 1000 µs pulse
      // appears longer, so a tight timeout would falsely expire.
      uint32_t pw = pulseIn(TUNING_PIN, LOW, 20000UL);
      if (pw == 0) {
        // pulseIn timed out — reference signal missing or way off frequency.
        // Abort this OSCCAL value.
        break;
      }
      gotAnyPulse = true;
      pulseSum += pw;
      validPulses++;
    }

    // If all pulses were valid, check if this OSCCAL is better than our best.
    if (validPulses == PULSE_COUNT) {
      // Short-circuit if the oscillator is already running far too fast
      // (pulseSum well below half the target). Higher cal = faster clock =
      // smaller pulseSum, so once we've fallen this far below the target
      // there is no point continuing the upward sweep.
      if (pulseSum < TARGET_PULSE_SUM / 2) {
        break;
      } else {
        // Compute absolute error from target.
        uint32_t error;
        if (pulseSum > TARGET_PULSE_SUM) {
          error = pulseSum - TARGET_PULSE_SUM;
        } else {
          error = TARGET_PULSE_SUM - pulseSum;
        }

        if (error < bestError) {
          bestError = error;
          bestOSCCAL = (int16_t)cal;
        }
      }
    }

    // Brief flash to show progress.
    ledOn();
    _delay_us(200);
    ledOff();

    _delay_us(300);  // small gap between measurements
  }

  // --- Restore factory OSCCAL ---
  // We're done stepping — put the clock back to a known-good state.
  restoreStockOSCCAL(stockCal6bit);

  // --- Evaluate result ---
  if (bestOSCCAL >= 0 && bestError <= ACCEPTABLE_TOLERANCE) {
    // SUCCESS — write calibrated value to USERROW.
    userrowWrite(0, (uint8_t)bestOSCCAL);

    // Verify the write took.
    uint8_t readback = userrowRead(0);
    if (readback == (uint8_t)bestOSCCAL) {
      // Solid LED = calibration complete and verified.
      ledOn();
      while (1);  // halt — board is ready for production firmware flash
    } else {
      blinkError(3);  // 3 blinks = USERROW write verify failed
    }
  } else if (!gotAnyPulse) {
    blinkError(1);  // 1 blink = no signal at all (wiring / Uno not running)
  } else {
    blinkError(2);  // 2 blinks = signal OK but no OSCCAL within tolerance
  }
}

// ---------------------------------------------------------------------------
// loop() — never reached; everything happens in setup()
// ---------------------------------------------------------------------------

void loop() {
  // Not used — calibration is a one-shot operation in setup().
}
